## app/boards/sidewalk_devkit_nrf54l15_nrf54l15_cpuapp.conf
```kconfig
#
# Copyright (c) 2026
#
# SPDX-License-Identifier: LicenseRef-Nordic-5-Clause
#

CONFIG_SIDEWALK_APPLICATION_NAME="sidewalk-devkit-sensor"
CONFIG_BT_DEVICE_NAME="Sidewalk Devkit"
CONFIG_SIDEWALK_BLE_NAME="Sidewalk Devkit"

CONFIG_SID_END_DEVICE_SENSOR_MONITORING=y
CONFIG_SID_END_DEVICE_SENSOR_TELEMETRY_PAYLOAD=y
CONFIG_SID_END_DEVICE_SENSOR_SAMPLE_LOG=y
CONFIG_SID_END_DEVICE_SENSOR_AUTO_TX=n
CONFIG_SID_END_DEVICE_SENSOR_LINK_AUTOSWITCH=y
CONFIG_SID_END_DEVICE_SENSOR_AUTOSWITCH_FSK_DELAY_S=20
CONFIG_SID_END_DEVICE_SENSOR_AUTOSWITCH_LORA_DELAY_S=60
CONFIG_SID_END_DEVICE_NOTIFY_DATA_PERIOD_MS=30000

CONFIG_SIDEWALK_SUBGHZ_SUPPORT=y
CONFIG_SIDEWALK_SUBGHZ_RADIO_SX126X=y
CONFIG_SIDEWALK_SUBGHZ_TRIM_CAP_VAL=0x1212
CONFIG_SIDEWALK_LINK_MASK_BLE=y
CONFIG_STATE_NOTIFIER=n

CONFIG_SID_END_DEVICE_CLI=y
CONFIG_SID_END_DEVICE_NUS_SHELL=y
CONFIG_SID_END_DEVICE_NUS_DEVICE_NAME="Sidewalk-WebShell"
CONFIG_SID_END_DEVICE_CLI_SENSOR_COMMANDS=y
CONFIG_SIDEWALK_LOCATION_SHELL=y
CONFIG_SHELL_BT_NUS_INIT_LOG_LEVEL_NONE=y
CONFIG_SHELL_BACKEND_SERIAL=y
CONFIG_BT_MAX_CONN=2
CONFIG_BT_EXT_ADV_LEGACY_SUPPORT=y
CONFIG_BT_EXT_ADV_MAX_ADV_SET=2

CONFIG_SERIAL=y
CONFIG_CONSOLE=y
CONFIG_UART_CONSOLE=y
CONFIG_LOG_BACKEND_UART=n
CONFIG_USE_SEGGER_RTT=n
CONFIG_RTT_CONSOLE=n
CONFIG_LOG_BACKEND_RTT=n
CONFIG_SHELL_BACKEND_RTT=n
CONFIG_MAIN_STACK_SIZE=8192
CONFIG_NRF_GRTC_START_SYSCOUNTER=y

CONFIG_GPIO=y
CONFIG_INPUT=y
CONFIG_INPUT_MODE_SYNCHRONOUS=y
CONFIG_SENSOR=y
CONFIG_TEMP_NRF5=n
CONFIG_SHT4X=y
CONFIG_ADXL367=y
CONFIG_ADXL367_TRIGGER_GLOBAL_THREAD=y
CONFIG_ADXL367_ACTIVITY_THRESHOLD=80
CONFIG_ADXL367_ACTIVITY_TIME=2
CONFIG_ADXL367_INACTIVITY_DETECTION_MODE=n
CONFIG_NPM1300_CHARGER=y
CONFIG_SID_END_DEVICE_FUEL_GAUGE=y
CONFIG_NRF_FUEL_GAUGE=y
CONFIG_NRF_FUEL_GAUGE_VARIANT_SECONDARY_CELL=y
CONFIG_REGULATOR=y
CONFIG_LED=y
CONFIG_LED_NPM1300=y

CONFIG_PM_DEVICE=y
CONFIG_PM_DEVICE_RUNTIME=y

CONFIG_HWINFO=y
CONFIG_NFC_T2T_NRFXLIB=y
CONFIG_SID_END_DEVICE_SENSOR_NFC_ID=y
```

## app/sysbuild/mcuboot/boards/sidewalk_devkit_nrf54l15_nrf54l15_cpuapp.conf
```kconfig
#
# Copyright (c) 2026
#
# SPDX-License-Identifier: LicenseRef-Nordic-5-Clause
#

CONFIG_FPROTECT=n
CONFIG_HW_STACK_PROTECTION=n
CONFIG_TICKLESS_KERNEL=y
CONFIG_BOOT_WATCHDOG_FEED=n
CONFIG_PM_OVERRIDE_EXTERNAL_DRIVER_CHECK=y

CONFIG_SPI=n
CONFIG_SPI_NOR=n
CONFIG_NORDIC_QSPI_NOR=n
```

## fsk_probe/boards/sidewalk_devkit_nrf54l15_nrf54l15_cpuapp.conf
```kconfig
#
# Copyright (c) 2026
#
# SPDX-License-Identifier: LicenseRef-Nordic-5-Clause
#

CONFIG_UART_CONSOLE=y
CONFIG_LOG_BACKEND_UART=y
CONFIG_USE_SEGGER_RTT=n
CONFIG_RTT_CONSOLE=n
CONFIG_LOG_BACKEND_RTT=n
CONFIG_NRF_GRTC_START_SYSCOUNTER=y
```
