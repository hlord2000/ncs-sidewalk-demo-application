## app/sysbuild/mcuboot/boards/xiao_nrf54l15_nrf54l15_cpuapp.conf
```kconfig
#
# Copyright (c) 2026
#
# SPDX-License-Identifier: LicenseRef-Nordic-5-Clause
#

# Match the nRF54L15 DK bootloader workarounds for the XIAO CPUAPP target.
CONFIG_FPROTECT=n
CONFIG_HW_STACK_PROTECTION=n
CONFIG_TICKLESS_KERNEL=y
CONFIG_BOOT_WATCHDOG_FEED=n
CONFIG_PM_OVERRIDE_EXTERNAL_DRIVER_CHECK=y

# The XIAO sample uses internal MRAM for both slots.
CONFIG_SPI=n
CONFIG_SPI_NOR=n
CONFIG_NORDIC_QSPI_NOR=n
```

## west.yml
```yaml
manifest:
  remotes:
    - name: ncs
      url-base: https://github.com/nrfconnect

  projects:
    - name: nrf
      remote: ncs
      repo-path: sdk-nrf
      revision: v3.0.0
      import: true

    - name: sidewalk
      remote: ncs
      repo-path: sdk-sidewalk
      revision: v1.1.0-add-on
```
